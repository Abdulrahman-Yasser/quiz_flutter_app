## AGL_Files/conf/bblayers.conf
```bitbake
# LAYER_CONF_VERSION is increased each time build/conf/bblayers.conf
# changes incompatibly
LCONF_VERSION = "7"

BBPATH = "${TOPDIR}"
BBFILES ?= ""

# Convenience variables usable in various configuration fragments
#----------------------------------
BCONFDIR := "${@os.path.abspath(os.path.dirname(d.getVar('FILE', True)))}"
METADIR  := "${@os.path.abspath('/media/abdu/LinuxHome/Embedded_Linux/git_ignoring/AGL/trout/external/poky/../..')}"

# These are the core OE + YP Layers
#----------------------------------
YOCTO_LAYERS = " \
  ${METADIR}/external/poky/meta \
  ${METADIR}/external/poky/meta-poky \
  ${METADIR}/external/meta-lts-mixins_rust \
  "
#  this is added for the boards where necessary, not globally
#  ${METADIR}/external/poky/meta-yocto-bsp \
#
# These are the AGL CORE Layers that make up the basis
# - they create a minimal bootable filesystem
#   with some automotive tools/libraries
#-----------------------------------------------------
AGL_CORE_LAYERS = " \
  ${METADIR}/meta-agl/meta-agl-core \
  ${METADIR}/meta-agl/meta-agl-bsp \
  "

# These are the direct dependencies of the AGL CORE Layers
#---------------------------------------------------------
AGL_CORE_DEPENDENCY_LAYERS = " \
  ${METADIR}/external/meta-openembedded/meta-oe \
  "

# Indirection to avoid duplicate inclusions of the same folder into BBLAYERS
# the evaluation is in the bblayers.conf.sample in meta-agl/meta-agl-core/conf/templates/base
AGL_META_NETWORKING ?= ""
AGL_META_PYTHON ?= ""
AGL_META_FILESYSTEMS ?= ""
AGL_META_MULTIMEDIA ?= ""
AGL_META_VIRTUALIZATION ?= ""
AGL_META_CLANG ?= ""
AGL_META_QT6 ?= ""

AGL_OTHER_DEPENDENCY_LAYERS = " \
    ${AGL_META_NETWORKING} \
    ${AGL_META_PYTHON} \
    ${AGL_META_FILESYSTEMS} \
    ${AGL_META_MULTIMEDIA} \
    ${AGL_META_VIRTUALIZATION} \
    ${AGL_META_CLANG} \
    ${AGL_META_QT6} \
    "

####################
# Combine the layers
BBLAYERS ?= " \
  ${AGL_OTHER_DEPENDENCY_LAYERS} \
  ${AGL_CORE_DEPENDENCY_LAYERS} \
  ${AGL_CORE_LAYERS} \
  ${YOCTO_LAYERS} \
  /media/abdu/LinuxHome/Embedded_Linux/yocto-layers/meta-flutter-task-app \
  "

BBLAYERS_NON_REMOVABLE ?= " \
  ${METADIR}/external/poky/meta \
  ${METADIR}/external/poky/meta-poky \
  ${METADIR}/meta-agl/meta-agl-core \
  "




# # # # # # # # # # # # # # # # # # # # # # # # # # # # # # # # # # # # # # # #
# fragment { 
# /media/abdu/LinuxHome/Embedded_Linux/git_ignoring/AGL/trout/meta-agl/templates/feature/agl-app-framework/50_bblayers.conf.inc
#

BBLAYERS =+ " \
	${METADIR}/meta-agl/meta-app-framework \
	"

#
# }
# # # # # # # # # # # # # # # # # # # # # # # # # # # # # # # # # # # # # # # #

# # # # # # # # # # # # # # # # # # # # # # # # # # # # # # # # # # # # # # # #
# fragment { 
# /media/abdu/LinuxHome/Embedded_Linux/git_ignoring/AGL/trout/meta-agl/templates/feature/agl-flutter/50_bblayers.conf.inc
#
AGL_META_CLANG = " ${METADIR}/external/meta-clang "
# Required for libcamera
AGL_META_MULTIMEDIA = "${METADIR}/external/meta-openembedded/meta-multimedia"
AGL_META_PYTHON = "${METADIR}/external/meta-openembedded/meta-python"

BBLAYERS =+ " \
   ${METADIR}/meta-agl/meta-agl-flutter \
   ${METADIR}/external/meta-flutter \
   ${METADIR}/external/meta-flutter/meta-flutter-apps \
"

#
# }
# # # # # # # # # # # # # # # # # # # # # # # # # # # # # # # # # # # # # # # #

# # # # # # # # # # # # # # # # # # # # # # # # # # # # # # # # # # # # # # # #
# fragment { 
# /media/abdu/LinuxHome/Embedded_Linux/git_ignoring/AGL/trout/meta-agl/templates/feature/agl-pipewire/50_bblayers.conf.inc
#
# PipeWire recipe comes from meta-multimedia
AGL_META_MULTIMEDIA = "${METADIR}/external/meta-openembedded/meta-multimedia"
AGL_META_PYTHON = "${METADIR}/external/meta-openembedded/meta-python"

BBLAYERS =+ " \
    ${METADIR}/meta-agl/meta-pipewire \
"

#
# }
# # # # # # # # # # # # # # # # # # # # # # # # # # # # # # # # # # # # # # # #
```
